## conf/layer.conf
```bitbake
# We have a conf and classes directory, add to BBPATH
BBPATH .= ":${LAYERDIR}"

# We have recipes-* directories, add to BBFILES
BBFILES += "${LAYERDIR}/recipes-*/*/*.bb \
            ${LAYERDIR}/recipes-*/*/*.bbappend"

BBFILE_COLLECTIONS += "meta-murata-wireless"
BBFILE_PATTERN_meta-murata-wireless = "^${LAYERDIR}/"
BBFILE_PRIORITY_meta-murata-wireless = "6"

LAYERSERIES_COMPAT_meta-murata-wireless = "sumo"
LAYERDEPENDS_meta-murata-wireless = "core"
```
